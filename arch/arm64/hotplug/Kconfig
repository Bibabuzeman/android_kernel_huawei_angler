## arch/arm64/hotplug/Kconfig
```kconfig
config BLU_PLUG
	bool "Dynamic hotplug driver"
	depends on HOTPLUG_CPU
	default n
	help
	  The Dynamic hotplug driver automatically online/offline CPUs proportional to system load.

config THUNDERPLUG_CONTROL
	bool "Enable plugging down/up of cores using powersuspend"
	default y
	help
	  This driver uses powersuspend to take down the cpu cores
	  on a octa core device.
```
